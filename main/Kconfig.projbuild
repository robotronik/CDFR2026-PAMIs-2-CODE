## main/Kconfig.projbuild
```kconfig
menu "Remote logging configuration"

    config ENABLE_REMOTE_LOGGING
        bool "Enable UDP remote logging"
        default y

    config WIFI_SSID
        string "WiFi SSID"
        default "myssid"
        help
            WiFi SSID for remote logging

    config WIFI_PASSWORD
        string "WiFi password"
        default "mypassword"
        help
            WiFi password for remote logging

    config UDP_LOG_PORT 
        int "UDP Broadcast port"
        default 1234
        help
            UDP message broadcasting port

endmenu
```

## sdkconfig.defaults
```kconfig
CONFIG_WIFI_SSID="Wifitronik"
CONFIG_WIFI_PASSWORD="36164626"
CONFIG_UDP_LOG_PORT=1234
CONFIG_HTTPD_WS_SUPPORT=y
```
